/********************************************************************/
// HC12 Program:	Assignment 10
// Processor:		MC9S12XDP512
// Xtal Speed:		16 MHz
// Author:			Brennan MacGregor
// Date:			November 3rd, 2015

// Details: A more detailed explanation of the program is entered here
/********************************************************************/


#include <hidef.h>      		/* common defines and macros 		*/
#include "derivative.h"      	/* derivative-specific definitions 	*/
#include "my_Lib.h"
/********************************************************************/
//		Library includes
/********************************************************************/

//#include "Your_Lib.h"


/********************************************************************/
//		Prototypes
/********************************************************************/


/********************************************************************/
//		Variables
/********************************************************************/


/********************************************************************/
//		Lookups
/********************************************************************/


void main(void)
{
// main entry point
_DISABLE_COP();

/********************************************************************/
// initializations
/********************************************************************/
SevSeg_ButtInit();
LCD_Init();

LCD_MyInitials();


	for (;;)
	{
	//main program loop
	  if (PT1AD1 & 0b00000100) // bottom
	  {
	      LCD_Addr(0x58);
	      LCD_String("Hola World!!");
	  }
	  
	  if (PT1AD1 & 0b00010000) // top
	  {
	      LCD_Ctrl(0b00000001);
	      LCD_Ctrl(0b00001110);
	      LCD_Addr(0x0);
	  }
	  
	  if (PT1AD1 & 0b00000001) // middle
	      LCD_MyInitials();
	}

}



/********************************************************************/
//		Functions
/********************************************************************/




/********************************************************************/
//		Interrupt Service Routines
/********************************************************************/

